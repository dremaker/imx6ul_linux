## drivers/mxc/magc/Kconfig
```kconfig
#
# SIM configuration
#

menu "MXC Magc Support"

config MXC_MAGC
	tristate "MXC magc support"
	default n
	---help---
	Say Y to get MXC magc support.

config MXC_MAGC_DEBUG
	bool "MXC magc debug support"
	depends on MXC_MAGC != n
	---help---
	Say Y to get MXC magc debug support.

endmenu
```

## drivers/mxc/sim/Kconfig
```kconfig
#
# SIM configuration
#

menu "MXC SIM Support"

config MXC_SIM
	tristate "MXC SIM support"
	default n
	---help---
	Say Y to get MXC SIM support.


config MXC_SIM_DEBUG
	bool "MXC SIM DEBUG support"
	depends on MXC_SIM != n
	---help---
	This is an option for use by developers; most people should say N here.  This enables SIM engine core and driver debugging.
	
endmenu
```
